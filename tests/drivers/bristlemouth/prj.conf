## CMakeLists.txt
```
# SPDX-License-Identifier: Apache-2.0

cmake_minimum_required(VERSION 3.20.0)

find_package(Zephyr REQUIRED HINTS $ENV{ZEPHYR_BASE})
project(tests_drivers_bristlemouth)

target_sources( app PRIVATE src/main.c)

include(${ZEPHYR_BASE}/samples/net/common/common.cmake)

set(gen_dir ${ZEPHYR_BINARY_DIR}/include/generated/)

add_definitions(
    -DOPENTHREAD_CONFIG_LOG_MAC=1
    -DOPENTHREAD_CONFIG_LOG_PLATFORM=1
)
```

## prj.conf
```kconfig
# Kernel options
CONFIG_MAIN_STACK_SIZE=4096
CONFIG_ENTROPY_GENERATOR=y
CONFIG_TEST_RANDOM_GENERATOR=y
CONFIG_INIT_STACKS=y

# Generic library options
CONFIG_NEWLIB_LIBC=y
CONFIG_POSIX_API=y
CONFIG_MAX_PTHREAD_COUNT=4

CONFIG_IEEE802154_DRIVER_LOG_LEVEL_DBG=y

# Logging
CONFIG_NET_LOG=y
CONFIG_NET_STATISTICS=y
CONFIG_PRINTK=y
CONFIG_LOG=y

CONFIG_LOG_STRDUP_MAX_STRING=128
CONFIG_LOG_STRDUP_BUF_COUNT=50
CONFIG_LOG_PROCESS_THREAD_SLEEP_MS=50

CONFIG_IEEE802154_BM_SERIAL=y
CONFIG_UART_PIPE=y
CONFIG_COBS=y
CONFIG_NET_CONFIG_IEEE802154_DEV_NAME="IEEE802154_UPIPE"
CONFIG_BM_SERIAL_DEV_NAME_0="UART_2"
CONFIG_BM_SERIAL_DEV_NAME_1=""
CONFIG_BM_SERIAL_DEV_NAME_2=""
```

## src/main.c
```c
/* main.c - OpenThread NCP */

/*
 * Copyright (c) 2020 Tridonic GmbH & Co KG
 *
 * SPDX-License-Identifier: Apache-2.0
 */
#include <zephyr.h>

#include <stdio.h>
#include <stdlib.h>
#include <unistd.h>

#include <device.h>
#include <devicetree.h>

#include <logging/log.h>
#include <drivers/console/bm_serial.h>

#define LOG_MODULE_NAME bm_test
LOG_MODULE_REGISTER(LOG_MODULE_NAME, LOG_LEVEL_DBG);

/* Basic test with 2 byte payload before delimiter */
static int basic_test_0 (void)
{
    int i;
    bm_ret_t ret;
    int success = 0;
    uint8_t test_buf[] = { 0x55, 0x55, 0X55, 0x55, 0x5A, 0xAA, 0xAA, 0xAA, 0xAA, 0xA9, 0xAA, 0xAA, 0xAA, 0x55, 0x55, 0x55, 0x55, 0x55, 0x55};
    uint8_t expected_out[] = {0xAA, 0xAA, 0xAA, 0xAA, 0xA9, 0xAA, 0xAA, 0xAA, 0x55, 0x55, 0x55, 0x55, 0x55, 0x55};

    for (i = 0; i < sizeof(test_buf); i++)
    {
        ret = bm_serial_process_byte(test_buf[i]);
    }

    if (ret.retval == 0 && ret.length == sizeof(expected_out))
    {
        success = 1;
        for (i = 0; i < sizeof(expected_out); i++)
        {
            if (expected_out[i] != ret.buf_ptr[i])
            {
                success = 0;
                break;
            }
        }
    }
    return success;
}

/* Missing preamble byte */
static int basic_test_1 (void)
{
    int i;
    bm_ret_t ret;
    int success = 0;
    uint8_t test_buf[] = { 0x55, 0x55, 0X55, 0x5A, 0xAA, 0xAA, 0xAA, 0xAA, 0xA9, 0xAA, 0xAA, 0xAA, 0x55, 0x55, 0x55, 0x55, 0x55, 0x55};

    for (i = 0; i < sizeof(test_buf); i++)
    {
        ret = bm_serial_process_byte(test_buf[i]);
    }

    if (ret.retval != 0)
    {
        success = 1;
    }
    return success;
}

/* Test case with preamble + delimiter within payload in a valid frame*/
static int basic_test_2 (void)
{
    int i;
    bm_ret_t ret;
    int success = 0;
    uint8_t test_buf[] = { 0x55, 0x55, 0X55, 0x55, 0x5A, 0xAA, 0xAA, 0xAA, 0xAA, 0xA5, 0xAA, 0xAA, 0xAA, 0x55, 0x55, 0x55, 0x55, 0x5A, 0x5A, 0x99, 0x99, 0x99, 0x99};
    uint8_t expected_out[] = {0xAA, 0xAA, 0xAA, 0xAA, 0xA5, 0xAA, 0xAA, 0xAA, 0x55, 0x55, 0x55, 0x55, 0x5A, 0x5A, 0x99, 0x99, 0x99, 0x99};

    for (i = 0; i < sizeof(test_buf); i++)
    {
        ret = bm_serial_process_byte(test_buf[i]);
    }

    if (ret.retval == 0 && ret.length == sizeof(expected_out))
    {
        success = 1;
        for (i = 0; i < sizeof(expected_out); i++)
        {
            if (expected_out[i] != ret.buf_ptr[i])
            {
                success = 0;
                break;
            }
        }
    }
    return success;
}

/* Missing delimiter byte */
static int basic_test_3 (void)
{
    int i;
    bm_ret_t ret;
    int success = 0;
    uint8_t test_buf[] = { 0x55, 0x55, 0X55, 0x55, 0xAA, 0xAA, 0xAA, 0xAA, 0xA9, 0xAA, 0xAA, 0xAA, 0x55, 0x55, 0x55, 0x55, 0x55, 0x55};

    for (i = 0; i < sizeof(test_buf); i++)
    {
        ret = bm_serial_process_byte(test_buf[i]);
    }

    if (ret.retval != 0)
    {
        success = 1;
    }
    return success;
}

/* Missing delimiter byte and following byte is */
static int basic_test_4 (void)
{
    int i;
    bm_ret_t ret;
    int success = 0;
    uint8_t test_buf[] = { 0x55, 0x55, 0X55, 0x55, 0x5A, 0xAA, 0xAA, 0xAA, 0xA9, 0xAA, 0xAA, 0xAA, 0x55, 0x55, 0x55, 0x55, 0x55, 0x55};

    for (i = 0; i < sizeof(test_buf); i++)
    {
        ret = bm_serial_process_byte(test_buf[i]);
    }

    if (ret.retval != 0)
    {
        success = 1;
    }
    return success;
}


void main(void)
{
    int ret;
    LOG_INF( "Testing the BM Serial driver" );

	while (1)
    {
        ret = basic_test_0();
        if(ret == 1)
        {
            printk("Basic Test 0 passed\n");
        }
        else
        {
            printk("Basic Test 0 failed\n");
        }

        ret = basic_test_1();
        if(ret == 1)
        {
            printk("Basic Test 1 passed\n");
        }
        else
        {
            printk("Basic Test 1 failed\n");
        }
        
        ret = basic_test_2();
        if(ret == 1)
        {
            printk("Basic Test 2 passed\n");
        }
        else
        {
            printk("Basic Test 2 failed\n");
        }

        ret = basic_test_3();
        if(ret == 1)
        {
            printk("Basic Test 3 passed\n");
        }
        else
        {
            printk("Basic Test 3 failed\n");
        }

        ret = basic_test_0();
        if(ret == 1)
        {
            printk("Basic Test 0 passed\n");
        }
        else
        {
            printk("Basic Test 0 failed\n");
        }

        ret = basic_test_4();
        if(ret == 1)
        {
            printk("Basic Test 4 passed\n");
        }
        else
        {
            printk("Basic Test 4 failed\n");
        }

        while(1);
    }
}
```
