## drivers/bm/Kconfig
```kconfig
# Bristlemouth Core config options

# Copyright (c) 2021-2022 Sofar Ocean Technologies
# SPDX-License-Identifier: Apache-2.0

# Core Bristlemouth drivers, subsystems, and features

menuconfig BM
	bool "Bristlemouth Core Library Support"
	help
	  This option enables the Bristlemouth Core features and services

if BM

# Serial Subsystem
config BM_SERIAL
	bool "Enable BM Serial multi-UART driver"
	select UART_INTERRUPT_DRIVEN
	select UART_ASYNC_API
	help
	  Enable Bristlemouth Serial driver

config BM_SERIAL_DEV_NAME_0
	string "Device Name of Bristlemouth IO Device 0"
	default "UART_2"
	help
	  This option specifies the name of Bristlemouth IO device 0

config BM_SERIAL_DEV_NAME_1
	string "Device Name of Bristlemouth IO Device 1"
	default ""
	help
	  This option specifies the name of Bristlemouth IO device 1

config BM_SERIAL_DEV_NAME_2
	string "Device Name of Bristlemouth IO Device 2"
	default ""
	help
	  This option specifies the name of Bristlemouth IO device 2 

config BM_NUM_FRAMES
	int "Number of Bristlemouth Frames in TX/RX sequential arrays"
	default 20
	help
	  This option can be used to modify the number of sequential frames
	  in the RX/TX buffers.

config BM_MAX_FRAME_SIZE
	int "Maximum number of bytes in a bristlemouth frame (header + payload)"
	default 261
	help
	  This option can be used to modify the max number of bytes in a bristlemouth
	  frame

config BM_TASK_STACK_SIZE
	int "Stack size of RX/TX Tasks in bm_serial.c"
	default 1024
	help
	  Stack size in bytes of RX/TX Tasks in bm_serial.c

config BM_MAX_SERIAL_DEV_COUNT
	int "Number of Serial Devices communicating on mesh network"
	default 3
	help
	  Number of Serial Devices communicating on mesh network

config BM_PREAMBLE_LEN
	int "Length of Preamble sent for every TX packet"
	default 4
	help
	  Length of Preamble (in bytes) sent for every TX packet

config BM_PREAMBLE_VAL
	int "Value of each Byte in TX preamble"
	default 85
	help
	  Value of each Byte in TX preamble

# DFU Subsystem
config BM_DFU
	bool "Enable Bristlemouth DFU Subsystem"
	select BM_SERIAL
	help
	  Enable Bristlemouth DFU subsystem, allowing image updates over the Bristlemouth network or serial interfaces

config BM_DFU_HOST
	bool "Enable Bristlemouth DFU Host Capability"
	default n
	help
	  Enable Bristlemouth DFU Host capabilities, or ability to send image to other device

config BM_DFU_CLIENT
	bool "Enable Bristlemouth DFU Client Capability"
	default n
	help
	  Enable Bristlemouth DFU Client capabilities, or ability to receive image from other device

config BM_DFU_NUM_FRAMES
	int "Number of Bristlemouth DFU Frames in TX/RX sequential arrays"
	default 2
	help
	  This option can be used to modify the number of sequential frames in the RX/TX buffers.

config BM_DFU_TASK_STACK_SIZE
	int "Stack size of RX/TX Tasks in bm_dfu.c"
	default 1024
	help
	  Stack size in bytes of RX/TX Tasks in bm_dfu.c

module = BM
module-str = Bristlemouth Core
source "${ZEPHYR_BASE}/subsys/logging/Kconfig.template.log_config"

endif # BM_CORE
```

## drivers/bristlemouth/Kconfig
```kconfig
# Bristlemouth drivers configuration options

# Copyright (c) 2022 Sofar Ocean Technologies
# SPDX-License-Identifier: Apache-2.0

menu "Bristlemouth Drivers"
	depends on NET_L2_BRISTLEMOUTH

module = NET_L2_BRISTLEMOUTH_DRIVER
module-dep = LOG
module-str = Log level for Bristlemouth driver
module-help = Sets log level for Bristlemouth Device Drivers.
source "subsys/net/Kconfig.template.log_config.net"

config BM_INIT_PRIORITY
	int "Bristlemouth driver init priority"
	default 80
	help
	  Bristlemouth device driver initialization priority.
	  Do not mess with it unless you know what you are doing.
	  Note that the priority needs to be lower than the net stack
	  so that it can start before the networking sub-system.


source "drivers/bristlemouth/Kconfig.stm32_hal"

endmenu # "Bristlemouth Drivers"
```

## drivers/bristlemouth/Kconfig.stm32_hal
```kconfig
# STM32 HAL Bristlemouth driver configuration options

# Copyright (c) 2022 Sofar Ocean Technologies
# SPDX-License-Identifier: Apache-2.0

menuconfig BM_STM32_HAL
	bool "STM32 HAL Bristlemouth driver"
	select UART_BM
	select UART_INTERRUPT_DRIVEN
	select SPSC_PBUF
	help
	  Enable STM32 HAL based Bristlemouth driver.

if BM_STM32_HAL

config BM_STM32_HAL_RX_THREAD_STACK_SIZE
	int "RX thread stack size"
	default 1500
	help
	  RX thread stack size

config BM_STM32_HAL_RX_THREAD_PRIO
	int "RX thread priority"
	default 2
	help
	  RX thread priority

config BM_STM32_HAL_TX_THREAD_STACK_SIZE
	int "TX thread stack size"
	default 1500
	help
	  TX thread stack size

config BM_STM32_HAL_TX_THREAD_PRIO
	int "TX thread priority"
	default 2
	help
	  TX thread priority

config BM_STM32_HAL_ENABLE_MANCHESTER_CODING
	bool "Enable Manchester coding"
	default y
	help
	  Enable Manchester coding and decoding of sent and received data

config BM_STM32_HAL_RANDOM_MAC
	bool "Random MAC address"
	depends on ENTROPY_GENERATOR
	default y
	help
	  Generate a random MAC address dynamically.

if !BM_STM32_HAL_RANDOM_MAC

config BM_STM32_HAL_MAC3
	hex "MAC Address Byte 3"
	default 0
	range 0 0xff
	help
	  This is the byte 3 of the MAC address.

config BM_STM32_HAL_MAC4
	hex "MAC Address Byte 4"
	default 0
	range 0 0xff
	help
	  This is the byte 4 of the MAC address.

config BM_STM32_HAL_MAC5
	hex "MAC Address Byte 5"
	default 0
	range 0 0xff
	help
	  This is the byte 5 of the MAC address.

endif # !BM_STM32_HAL_RANDOM_MAC

config BM_STM32_HAL_SERIAL_DEV_NAME_0
	string "Device Name of Bristlemouth IO Device 0"
	default "UART_2"
	help
	  This option specifies the name of Bristlemouth IO device 0

config BM_STM32_HAL_SERIAL_DEV_NAME_1
	string "Device Name of Bristlemouth IO Device 1"
	default ""
	help
	  This option specifies the name of Bristlemouth IO device 1

config BM_STM32_HAL_SERIAL_DEV_NAME_2
	string "Device Name of Bristlemouth IO Device 2"
	default ""
	help
	  This option specifies the name of Bristlemouth IO device 2 

config BM_STM32_HAL_NUM_FRAMES
	int "Number of Bristlemouth Frames in TX/RX sequential arrays"
	default 20
	help
	  This option can be used to modify the number of sequential frames
	  in the RX/TX buffers.

config BM_STM32_HAL_MAX_FRAME_SIZE
	int "Maximum number of bytes in a bristlemouth frame (header + payload)"
	default 261
	help
	  This option can be used to modify the max number of bytes in a bristlemouth
	  frame

config BM_STM32_HAL_TASK_STACK_SIZE
	int "Stack size of RX/TX Tasks in bm_serial.c"
	default 1024
	help
	  Stack size in bytes of RX/TX Tasks in bm_serial.c

config BM_STM32_HAL_MAX_SERIAL_DEV_COUNT
	int "Number of Serial Devices communicating on mesh network"
	default 3
	help
	  Number of Serial Devices communicating on mesh network

config BM_STM32_HAL_PREAMBLE_LEN
	int "Length of Preamble sent for every TX packet"
	default 4
	help
	  Length of Preamble (in bytes) sent for every TX packet

config BM_STM32_HAL_PREAMBLE_VAL
	int "Value of each Byte in TX preamble"
	default 85
	help
	  Value of each Byte in TX preamble

endif # BM_STM32_HAL
```

## drivers/ethernet/Kconfig.adin1110
```kconfig
# ADIN1110 Ethernet driver configuration options

# Sofar Ocean Technologies 2022

menuconfig ETH_ADIN1110
	bool "ADIN1110 Ethernet driver"
	default y
	select SPI
	help
	  ADIN1110 Ethernet Controller
	  with SPI Interface

if ETH_ADIN1110

config ETH_ADIN1110_RX_THREAD_STACK_SIZE
	int "Stack size for internal incoming packet handler"
	default 800
	help
	  Size of the stack used for internal thread which is ran for
	  incoming packet processing.

config ETH_ADIN1110_RX_THREAD_PRIO
	int "Priority for internal incoming packet handler"
	default 2
	help
	  Priority level for internal thread which is ran for incoming
	  packet processing.

config ETH_ADIN1110_TIMEOUT
	int "IP buffer timeout"
	default 100
	help
	  Given timeout in milliseconds. Maximum amount of time
	  that the driver will wait from the IP stack to get
	  a memory buffer before the Ethernet frame is dropped.

config ETH_ADIN1110_SPI_CRC_ENABLE
	bool
	default y
	help
		Use CRC8 in SPI MAC transactions to ADIN1110

endif # ETH_ADIN1110
```

## drivers/ethernet/Kconfig.adin2111
```kconfig
# ADIN2111 Ethernet driver configuration options

# Sofar Ocean Technologies 2022

menuconfig ETH_ADIN2111
	bool "ADIN2111 Ethernet driver"
	default y
	select SPI
	help
	  ADIN2111 Ethernet Controller
	  with SPI Interface

if ETH_ADIN2111

config ETH_ADIN2111_BSP_THREAD_STACK_SIZE
	int "Stack size for interrupt servicing"
	default 1024
	help
	  Size of the stack used for internal thread which is ran for
	  incoming packet processing.

config ETH_ADIN2111_BSP_THREAD_PRIO
	int "Priority for interrupt servicing"
	default 10
	help
	  Priority level for internal thread which is ran for incoming
	  packet processing.

config ETH_ADIN2111_SERVICE_THREAD_STACK_SIZE
	int "Stack size for TX/RX packet handler"
	default 1024
	help
	  Size of the stack used for internal thread which is ran for
	  incoming packet processing.

config ETH_ADIN2111_SERVICE_THREAD_PRIO
	int "Priority for TX/RX packet handler"
	default 15
	help
	  Priority level for internal thread which is ran for incoming
	  packet processing.

config ETH_ADIN2111_TIMEOUT
	int "IP buffer timeout"
	default 100
	help
	  Given timeout in milliseconds. Maximum amount of time
	  that the driver will wait from the IP stack to get
	  a memory buffer before the Ethernet frame is dropped.

config ETH_ADIN2111_SPI_CRC_ENABLE
	bool
	default y
	help
		Use CRC8 in SPI MAC transactions to ADIN2111

config SPI_OA_EN
	bool
	default y
	help
		Use Open Alliance SPI to communicate to ADIN2111

config SPI_PROT_EN
	bool
	default y
	help
		Use Open Alliance SPI Protection (CRC)

endif # ETH_ADIN2111
```

## dts/bindings/ethernet/analog,adin2111.yaml
```yaml
# Copyright (c) 2020 Linumiz
# SPDX-License-Identifier: Apache-2.0

description: Analong ADIN2111 standalone 10/100BASE-T Ethernet controller with SPI interface

compatible: "analog,adin2111"

include: [spi-device.yaml, ethernet.yaml]

properties:
    int-gpios:
      type: phandle-array
      required: false
      description: Interrupt pin.

        The interrupt pin of W5500 is active low.
        If connected directly the MCU pin should be configured
        as active low.
    reset-gpios:
      type: phandle-array
      required: false
      description: Reset pin.

        The reset pin of W5500 is active low.
        If connected directly the MCU pin should be configured
        as active low.
```

## dts/bindings/serial/st,stm32-usart-bm.yaml
```yaml
description: STM32 USART BM

compatible: "st,stm32-usart-bm"

include: [uart-controller.yaml, pinctrl-device.yaml]

properties:
    reg:
      required: true

    interrupts:
      required: true

    pinctrl-0:
      required: true

    pinctrl-names:
      required: true
```

## lib/cobs/Kconfig
```kconfig
# Copyright (c) 2018 Nordic Semiconductor
# SPDX-License-Identifier: Apache-2.0

config COBS
	bool "COBS Support"
	help
	  This option enables the COBS library
```

## subsys/net/l2/bristlemouth/Kconfig
```kconfig
# Copyright (c) 2022 Sofar Ocean Technologies
# SPDX-License-Identifier: Apache-2.0

menuconfig NET_L2_BRISTLEMOUTH
	bool "Enable Bristlemouth support"
	help
	  Enable support for Bristlemouth network interfaces

if NET_L2_BRISTLEMOUTH

module = NET_L2_BRISTLEMOUTH
module-dep = NET_LOG
module-str = Log level for Bristlemouth L2 layer
module-help = Enables Bristlemouth L2 to output debug messages.
source "subsys/net/Kconfig.template.log_config.net"

endif # NET_L2_BRISTLEMOUTH
```
