## CMakeLists.txt
```
# SPDX-License-Identifier: Apache-2.0

cmake_minimum_required(VERSION 3.20.0)

find_package(Zephyr REQUIRED HINTS $ENV{ZEPHYR_BASE})
project(net_bm_serial_test)

target_sources( app PRIVATE src/main.c)

include(${ZEPHYR_BASE}/samples/net/common/common.cmake)

set(gen_dir ${ZEPHYR_BINARY_DIR}/include/generated/)

add_definitions(
    -DOPENTHREAD_CONFIG_LOG_MAC=1
    -DOPENTHREAD_CONFIG_LOG_PLATFORM=1
)
```

## prj.conf
```kconfig
# Kernel options
CONFIG_MAIN_STACK_SIZE=4096
CONFIG_ENTROPY_GENERATOR=y
CONFIG_TEST_RANDOM_GENERATOR=y
CONFIG_INIT_STACKS=y

# Generic library options
CONFIG_NEWLIB_LIBC=y
CONFIG_POSIX_API=y
CONFIG_MAX_PTHREAD_COUNT=4

# Logging
CONFIG_NET_LOG=y
CONFIG_NET_STATISTICS=y
CONFIG_PRINTK=y
CONFIG_LOG=y

# Networking config
CONFIG_NETWORKING=y
CONFIG_NET_IPV4=y
CONFIG_NET_IPV6=y
CONFIG_NET_IPV6_MLD=n
CONFIG_NET_IPV6_NBR_CACHE=n
CONFIG_NET_SOCKETS=y
CONFIG_NET_SOCKETS_POLL_MAX=4

# TODO: Can these be placed as dependencies/selections in their respective libraries
CONFIG_BOOTLOADER_MCUBOOT=y
CONFIG_FLASH=y
CONFIG_IMG_MANAGER=y
CONFIG_REBOOT=y

CONFIG_BM_STM32_HAL=y
CONFIG_BM_STM32_HAL_RANDOM_MAC=y
CONFIG_BM_STM32_HAL_ENABLE_MANCHESTER_CODING=n
CONFIG_BM_STM32_HAL_MAC3=0xAB
CONFIG_BM_STM32_HAL_MAC4=0xCD
CONFIG_BM_STM32_HAL_MAC5=0xAB
CONFIG_BM_STM32_HAL_NUM_FRAMES=5
CONFIG_BM_STM32_HAL_MAX_FRAME_SIZE=1524

CONFIG_UART_BM=y
CONFIG_BM_STM32_HAL_MAX_SERIAL_DEV_COUNT=3
CONFIG_BM_STM32_HAL_SERIAL_DEV_NAME_0="UART_1"
CONFIG_BM_STM32_HAL_SERIAL_DEV_NAME_1="UART_2"
CONFIG_BM_STM32_HAL_SERIAL_DEV_NAME_2="UART_3"
CONFIG_BM_DFU_SERIAL_DEV_NAME="UART_4"

# Logging
CONFIG_LOG=y
CONFIG_PRINTK=y
CONFIG_NET_LOG=y
CONFIG_NET_STATISTICS=y

# Log Levels
CONFIG_NET_CORE_LOG_LEVEL_DBG=n
CONFIG_NET_IPV6_LOG_LEVEL_DBG=n
CONFIG_NET_CONN_LOG_LEVEL_DBG=n
CONFIG_NET_L2_BRISTLEMOUTH_LOG_LEVEL_DBG=n
CONFIG_NET_L2_BRISTLEMOUTH_DRIVER_LOG_LEVEL_INF=n

# DFU Specific 
CONFIG_BM_DFU=y
CONFIG_BM_DFU_HOST=n
CONFIG_BM_DFU_CLIENT=y
CONFIG_BM_DFU_SERIAL=y
CONFIG_BM_DFU_NUM_FRAMES=2
CONFIG_SMF=y
CONFIG_SMF_ANCESTOR_SUPPORT=y
CONFIG_COBS=y
CONFIG_BM_DFU_TASK_STACK_SIZE=1024
```

## src/main.c
```c
/* main.c - OpenThread NCP */

/*
 * Copyright (c) 2020 Tridonic GmbH & Co KG
 *
 * SPDX-License-Identifier: Apache-2.0
 */
#include <zephyr.h>

#include <stdio.h>
#include <stdlib.h>
#include <stdbool.h>
#include <unistd.h>

#include <device.h>
#include <devicetree.h>
#include <drivers/gpio.h>

#include <logging/log.h>

#define LOG_MODULE_NAME bristlemouth_test
LOG_MODULE_REGISTER(LOG_MODULE_NAME, LOG_LEVEL_DBG);

void main(void)
{
    LOG_INF( "Performing DFU over BM serial");
}
```
