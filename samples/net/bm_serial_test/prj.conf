## Kconfig
```
# Private config options for bristlemouth test app

# Copyright (c) 2018 Intel Corporation
# SPDX-License-Identifier: Apache-2.0

mainmenu "Networking bristlemouth sample application"

config BRISTLEMOUTH_UART_OT
	bool "Enable UART Pipe network interface for OpenThread"
	depends on NET_L2_OPENTHREAD
	help
	  Enable this flag to to allow creation of a UPIPE
	  network interface, usable by 802.15.4/OpenThread

source "Kconfig.zephyr"
```

## prj.conf
```kconfig
# Kernel options
CONFIG_MAIN_STACK_SIZE=4096
CONFIG_ENTROPY_GENERATOR=y
CONFIG_TEST_RANDOM_GENERATOR=y
CONFIG_INIT_STACKS=y

# Generic library options
CONFIG_NEWLIB_LIBC=y
CONFIG_POSIX_API=y
CONFIG_MAX_PTHREAD_COUNT=4

# Logging
CONFIG_NET_LOG=y
CONFIG_NET_STATISTICS=y
CONFIG_PRINTK=y
CONFIG_LOG=y

CONFIG_BM_SERIAL=y
CONFIG_IEEE802154_BM_SERIAL=y
# CONFIG_UART_PIPE=y
CONFIG_NET_CONFIG_IEEE802154_DEV_NAME="IEEE802154_UPIPE"
CONFIG_BM_SERIAL_DEV_NAME_0="UART_2"
CONFIG_BM_SERIAL_DEV_NAME_1="UART_3"
CONFIG_BM_SERIAL_DEV_NAME_2=""

CONFIG_UART_STM32_BM=y
CONFIG_BM_NUM_FRAMES=40
CONFIG_BM_MAX_FRAME_SIZE=261
CONFIG_BM_TASK_STACK_SIZE=2048
CONFIG_BM_MAX_SERIAL_DEV_COUNT=3
CONFIG_BM_PREAMBLE_LEN=4
# Preamble value of 0x55 is 85 in decimal
CONFIG_BM_PREAMBLE_VAL=85

CONFIG_UART_INTERRUPT_DRIVEN=y
```

## src/main.c
```c
/* main.c - OpenThread NCP */

/*
 * Copyright (c) 2020 Tridonic GmbH & Co KG
 *
 * SPDX-License-Identifier: Apache-2.0
 */
#include <zephyr.h>

#include <stdio.h>
#include <stdlib.h>
#include <unistd.h>

#include <device.h>
#include <devicetree.h>
#include <drivers/gpio.h>
#include <logging/log.h>
#include <drivers/bm/bm_serial.h>
#include <net/ieee802154_radio.h>
#include <storage/flash_map.h>
#include <sys/crc.h>

#define LOG_MODULE_NAME bm_test
LOG_MODULE_REGISTER(bm_serial_test, LOG_LEVEL_DBG);

static struct k_thread _rx_thread_data;
K_THREAD_STACK_DEFINE( _rx_stack, 1024);

uint8_t tx_buf[259];
uint8_t init_msg[] = "Hi from Device #3";
bm_frame_header_t frm_hdr = {BM_V0, BM_IEEE802154, sizeof(init_msg)};

static void _rx_thread(void)
{
    struct k_msgq* rx_queue = NULL;
    bm_msg_t msg;
    uint16_t frame_length;
    uint16_t payload_length;
    int retval;

    while (rx_queue == NULL)
    {
        rx_queue = bm_serial_get_rx_msgq_handler();
    } 

    while (1)
    {
        // Wait on bm_serial.c RX Thread to put message on queue
        k_msgq_get(rx_queue, &msg, K_FOREVER);

        frame_length = msg.frame_length;
        payload_length = frame_length - sizeof(bm_frame_header_t);
        uint8_t bm_payload_type = ((bm_frame_header_t*) msg.frame_addr)->payload_type;

        if (bm_payload_type != BM_IEEE802154)
        {
        	LOG_ERR("Incompatible version. Discarding Frame");
        	continue;
        }
        else
        {
            frm_hdr.payload_length = payload_length;
            memcpy(tx_buf, &frm_hdr, sizeof(bm_frame_header_t));
            //memcpy(&tx_buf[sizeof(bm_frame_header_t)], &msg.frame_addr[sizeof(bm_frame_header_t)], frm_hdr.payload_length);
            memcpy(&tx_buf[sizeof(bm_frame_header_t)], init_msg, frm_hdr.payload_length);
            bm_frame_t *bm_frm = (bm_frame_t *)tx_buf;

            retval = bm_serial_frm_put(bm_frm, BM_END_DEVICE);
            
            if (retval)
            {
                LOG_ERR( "TX MessageQueue is full, dropping message!");
            }
            else
            {
                //LOG_INF("Forwarded message: %s", &msg.frame_addr[sizeof(bm_frame_header_t)]);
            }
            LOG_INF("Msg: %s", &msg.frame_addr[sizeof(bm_frame_header_t)]);
        }
    }
}

void main(void)
{
    LOG_INF( "Testing the BM Serial driver" );

    int retval;

    memcpy(tx_buf, &frm_hdr, sizeof(bm_frame_header_t));
    memcpy(&tx_buf[sizeof(bm_frame_header_t)], init_msg, frm_hdr.payload_length);
    bm_frame_t *bm_frm = (bm_frame_t *)tx_buf;

    k_thread_create(&_rx_thread_data, _rx_stack,
        K_THREAD_STACK_SIZEOF(_rx_stack),
        (k_thread_entry_t) _rx_thread,
        NULL, NULL, NULL, K_PRIO_COOP(5), 0, K_NO_WAIT);

    while (1)
    {
        usleep(10000UL);
        // retval = bm_serial_frm_put(bm_frm, BM_END_DEVICE);
        
        // if (retval)
        // {
        //     LOG_ERR( "TX MessageQueue is full, dropping message!");
        // }
    }
}
```
