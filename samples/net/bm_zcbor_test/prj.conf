## CMakeLists.txt
```
# SPDX-License-Identifier: Apache-2.0

cmake_minimum_required(VERSION 3.20.0)

find_package(Zephyr REQUIRED HINTS $ENV{ZEPHYR_BASE})
project(net_bm_serial_test)

target_sources( app PRIVATE src/main.c)
target_sources( app PRIVATE src/bm_zcbor_decode.c)
target_sources( app PRIVATE src/bm_zcbor_encode.c)

include(${ZEPHYR_BASE}/samples/net/common/common.cmake)

zephyr_include_directories(include)

set(gen_dir ${ZEPHYR_BINARY_DIR}/include/generated/)

add_definitions(
    -DOPENTHREAD_CONFIG_LOG_MAC=1
    -DOPENTHREAD_CONFIG_LOG_PLATFORM=1
) 
```

## Kconfig
```
# Private config options for bristlemouth test app

# Copyright (c) 2018 Intel Corporation
# SPDX-License-Identifier: Apache-2.0

mainmenu "Networking bristlemouth sample application"

config BRISTLEMOUTH_UART_OT
	bool "Enable UART Pipe network interface for OpenThread"
	depends on NET_L2_OPENTHREAD
	help
	  Enable this flag to to allow creation of a UPIPE
	  network interface, usable by 802.15.4/OpenThread

source "Kconfig.zephyr" 
```

## sample.yaml
```
common:
  harness: net
  tags: net
  depends_on: netif
  min_flash: 140
sample:
  description: Testing bm_serial w/ ZCBOR
  name: BM Serial ZCBOR
```

## prj.conf
```kconfig
# Kernel options
CONFIG_MAIN_STACK_SIZE=4096
CONFIG_ENTROPY_GENERATOR=y
CONFIG_TEST_RANDOM_GENERATOR=y
CONFIG_INIT_STACKS=y

# Generic library options
CONFIG_NEWLIB_LIBC=y
CONFIG_POSIX_API=y
CONFIG_MAX_PTHREAD_COUNT=4

# Logging
CONFIG_NET_LOG=y
CONFIG_NET_STATISTICS=y
CONFIG_PRINTK=y
CONFIG_LOG=y

CONFIG_BM_SERIAL=y
CONFIG_IEEE802154_BM_SERIAL=y
CONFIG_NET_CONFIG_IEEE802154_DEV_NAME="IEEE802154_UPIPE"
CONFIG_BM_SERIAL_DEV_NAME_0="UART_2"
CONFIG_BM_SERIAL_DEV_NAME_1="UART_3"
CONFIG_BM_SERIAL_DEV_NAME_2=""
CONFIG_BM_DFU_SERIAL_DEV_NAME=""

CONFIG_UART_STM32_BM=y
CONFIG_BM_NUM_FRAMES=40
CONFIG_BM_MAX_FRAME_SIZE=261
CONFIG_BM_TASK_STACK_SIZE=1024
CONFIG_BM_MAX_SERIAL_DEV_COUNT=3
CONFIG_BM_PREAMBLE_LEN=4
# Preamble value of 0x55 is 85 in decimal
CONFIG_BM_PREAMBLE_VAL=85

CONFIG_ZCBOR=y
# CONFIG_BOOTLOADER_MCUBOOT=y 
```

## src/main.c
```c
/* main.c - OpenThread NCP */

/*
 * Copyright (c) 2020 Tridonic GmbH & Co KG
 *
 * SPDX-License-Identifier: Apache-2.0
 */
#include <zephyr.h>

#include <stdio.h>
#include <stdlib.h>
#include <unistd.h>

#include <device.h>
#include <devicetree.h>
#include <drivers/gpio.h>
#include <logging/log.h>
#include <drivers/bm/bm_serial.h>
#include <net/ieee802154_radio.h>
#include <storage/flash_map.h>
#include <sys/crc.h>

#include <zcbor_common.h>
#include <zcbor_decode.h>
#include <zcbor_encode.h>

#include "bm_zcbor_decode.h"
#include "bm_zcbor_encode.h"

#define LOG_MODULE_NAME bm_test
LOG_MODULE_REGISTER(bm_serial_test, LOG_LEVEL_DBG);

static struct k_thread _rx_thread_data;
K_THREAD_STACK_DEFINE( _rx_stack, 1024);

uint8_t tx_buf[259];
//uint8_t init_msg[] = "Hi from Device #1";
bm_frame_header_t frm_hdr = {BM_V0, BM_IEEE802154, NULL};

static void _rx_thread(void)
{
    struct k_msgq* rx_queue = NULL;
    bm_msg_t msg;
    uint16_t frame_length;
    uint16_t payload_length;
    int retval;

    struct Pet pet;
	size_t decode_len;

    while (rx_queue == NULL)
    {
        rx_queue = bm_serial_get_rx_msgq_handler();
    } 

    while (1)
    {
        // Wait on bm_serial.c RX Thread to put message on queue
        k_msgq_get(rx_queue, &msg, K_FOREVER);

        frame_length = msg.frame_length;
        payload_length = frame_length - sizeof(bm_frame_header_t);
        uint8_t bm_payload_type = ((bm_frame_header_t*) msg.frame_addr)->payload_type;

        if (bm_payload_type != BM_IEEE802154)
        {
            LOG_ERR("Incompatible version. Discarding Frame");
            continue;
        }
        else
        {
            retval = cbor_decode_Pet(&msg.frame_addr[sizeof(bm_frame_header_t)], payload_length, &pet, &decode_len);

            if (retval)
            {
                LOG_ERR("CBOR Decode error");
            }
            else
            {
                LOG_INF("Num pets: %d", pet._Pet_name_names_count);
                LOG_INF("Pet name 1: %.*s", pet._Pet_name_names[0].len, pet._Pet_name_names[0].value);
                LOG_INF("Pet name 2: %.*s", pet._Pet_name_names[1].len, pet._Pet_name_names[1].value);
            }
        }
    }
}

void main(void)
{
    LOG_INF( "Testing the BM Serial driver" );

    int retval;
    uint8_t output[25];
	size_t out_len;

    struct Pet pet = 
    {
        ._Pet_name_names = {{.value = "fido", .len = 4}, {.value = "arfer", .len = 5}},
        ._Pet_name_names_count = 2,
        ._Pet_birthday = {.value = (uint8_t[]){1,2,3,4,5,6,7,8}, .len = 8},
        ._Pet_species_choice = _Pet_species_dog
    };

    retval = cbor_encode_Pet(output, sizeof(output), &pet, &out_len);

    if (retval)
    {
        LOG_ERR("CBOR encoding error");
    }

    frm_hdr.payload_length = sizeof(output);

    memcpy(tx_buf, &frm_hdr, sizeof(bm_frame_header_t));
    memcpy(&tx_buf[sizeof(bm_frame_header_t)], output, sizeof(output));
    bm_frame_t *bm_frm = (bm_frame_t *)tx_buf;

    k_thread_create(&_rx_thread_data, _rx_stack,
        K_THREAD_STACK_SIZEOF(_rx_stack),
        (k_thread_entry_t) _rx_thread,
        NULL, NULL, NULL, K_PRIO_COOP(5), 0, K_NO_WAIT);

    while (1)
    {
        usleep(1000000UL);
        retval = bm_serial_frm_put(bm_frm, BM_END_DEVICE);

        if (retval)
        {
            LOG_ERR( "TX MessageQueue is full, dropping message!");
        }
    }
} 
```

## include/bm_zcbor_decode.h
```c
/*
 * Generated using zcbor version 0.5.99
 * https://github.com/NordicSemiconductor/zcbor
 * Generated with a --default-max-qty of 3
 */

#ifndef BM_ZCBOR_DECODE_H__
#define BM_ZCBOR_DECODE_H__

#include <stdint.h>
#include <stdbool.h>
#include <stddef.h>
#include <string.h>
#include "zcbor_decode.h"
#include "bm_zcbor_types.h"

#if DEFAULT_MAX_QTY != 3
#error "The type file was generated with a different default_max_qty than this file"
#endif


int cbor_decode_Pet(
		const uint8_t *payload, size_t payload_len,
		struct Pet *result,
		size_t *payload_len_out);


#endif /* BM_ZCBOR_DECODE_H__ */
```

## include/bm_zcbor_encode.h
```c
/*
 * Generated using zcbor version 0.5.99
 * https://github.com/NordicSemiconductor/zcbor
 * Generated with a --default-max-qty of 3
 */

#ifndef BM_ZCBOR_ENCODE_H__
#define BM_ZCBOR_ENCODE_H__

#include <stdint.h>
#include <stdbool.h>
#include <stddef.h>
#include <string.h>
#include "zcbor_encode.h"
#include "bm_zcbor_types.h"

#if DEFAULT_MAX_QTY != 3
#error "The type file was generated with a different default_max_qty than this file"
#endif


int cbor_encode_Pet(
		uint8_t *payload, size_t payload_len,
		const struct Pet *input,
		size_t *payload_len_out);


#endif /* BM_ZCBOR_ENCODE_H__ */
```

## include/bm_zcbor_types.h
```c
/*
 * Generated using zcbor version 0.5.99
 * https://github.com/NordicSemiconductor/zcbor
 * Generated with a --default-max-qty of 3
 */

#ifndef BM_ZCBOR_TYPES_H__
#define BM_ZCBOR_TYPES_H__

#include <stdint.h>
#include <stdbool.h>
#include <stddef.h>
#include <string.h>
#include "zcbor_encode.h"

/** Which value for --default-max-qty this file was created with.
 *
 *  The define is used in the other generated file to do a build-time
 *  compatibility check.
 *
 *  See `zcbor --help` for more information about --default-max-qty
 */
#define DEFAULT_MAX_QTY 3

struct Pet {
	struct zcbor_string _Pet_name_names[3];
	uint_fast32_t _Pet_name_names_count;
	struct zcbor_string _Pet_birthday;
	enum {
		_Pet_species_cat = 1,
		_Pet_species_dog = 2,
		_Pet_species_other = 3,
	} _Pet_species_choice;
};


#endif /* BM_ZCBOR_TYPES_H__ */
```

## src/bm_zcbor_decode.c
```c
/*
 * Generated using zcbor version 0.5.99
 * https://github.com/NordicSemiconductor/zcbor
 * Generated with a --default-max-qty of 3
 */

#include <stdint.h>
#include <stdbool.h>
#include <stddef.h>
#include <string.h>
#include "zcbor_decode.h"
#include "bm_zcbor_decode.h"

#if DEFAULT_MAX_QTY != 3
#error "The type file was generated with a different default_max_qty than this file"
#endif

static bool decode_Pet(zcbor_state_t *state, struct Pet *result);


static bool decode_Pet(
		zcbor_state_t *state, struct Pet *result)
{
	zcbor_print("%s\r\n", __func__);

	bool tmp_result = (((zcbor_list_start_decode(state) && ((((zcbor_list_start_decode(state) && ((zcbor_multi_decode(1, 3, &(*result)._Pet_name_names_count, (zcbor_decoder_t *)zcbor_tstr_decode, state, (&(*result)._Pet_name_names), sizeof(struct zcbor_string))) || (zcbor_list_map_end_force_decode(state), false)) && zcbor_list_end_decode(state)))
	&& ((zcbor_bstr_decode(state, (&(*result)._Pet_birthday)))
	&& ((((((*result)._Pet_birthday.len >= 8)
	&& ((*result)._Pet_birthday.len <= 8)) || (zcbor_error(state, ZCBOR_ERR_WRONG_RANGE), false))) || (zcbor_error(state, ZCBOR_ERR_WRONG_RANGE), false)))
	&& ((((zcbor_int_decode(state, &(*result)._Pet_species_choice, sizeof((*result)._Pet_species_choice)))) && ((((((*result)._Pet_species_choice == _Pet_species_cat) && ((1)))
	|| (((*result)._Pet_species_choice == _Pet_species_dog) && ((1)))
	|| (((*result)._Pet_species_choice == _Pet_species_other) && ((1)))) || (zcbor_error(state, ZCBOR_ERR_WRONG_VALUE), false)))))) || (zcbor_list_map_end_force_decode(state), false)) && zcbor_list_end_decode(state))));

	if (!tmp_result)
		zcbor_trace();

	return tmp_result;
}



int cbor_decode_Pet(
		const uint8_t *payload, size_t payload_len,
		struct Pet *result,
		size_t *payload_len_out)
{
	zcbor_state_t states[4];

	zcbor_new_state(states, sizeof(states) / sizeof(zcbor_state_t), payload, payload_len, 1);

	bool ret = decode_Pet(states, result);

	if (ret && (payload_len_out != NULL)) {
		*payload_len_out = MIN(payload_len,
				(size_t)states[0].payload - (size_t)payload);
	}

	if (!ret) {
		int err = zcbor_pop_error(states);

		zcbor_print("Return error: %d\r\n", err);
		return (err == ZCBOR_SUCCESS) ? ZCBOR_ERR_UNKNOWN : err;
	}
	return ZCBOR_SUCCESS;
}
```

## src/bm_zcbor_encode.c
```c
/*
 * Generated using zcbor version 0.5.99
 * https://github.com/NordicSemiconductor/zcbor
 * Generated with a --default-max-qty of 3
 */

#include <stdint.h>
#include <stdbool.h>
#include <stddef.h>
#include <string.h>
#include "zcbor_encode.h"
#include "bm_zcbor_encode.h"

#if DEFAULT_MAX_QTY != 3
#error "The type file was generated with a different default_max_qty than this file"
#endif

static bool encode_Pet(zcbor_state_t *state, const struct Pet *input);


static bool encode_Pet(
		zcbor_state_t *state, const struct Pet *input)
{
	zcbor_print("%s\r\n", __func__);

	bool tmp_result = (((zcbor_list_start_encode(state, 3) && ((((zcbor_list_start_encode(state, 3) && ((zcbor_multi_encode_minmax(1, 3, &(*input)._Pet_name_names_count, (zcbor_encoder_t *)zcbor_tstr_encode, state, (&(*input)._Pet_name_names), sizeof(struct zcbor_string))) || (zcbor_list_map_end_force_encode(state), false)) && zcbor_list_end_encode(state, 3)))
	&& (((((((*input)._Pet_birthday.len >= 8)
	&& ((*input)._Pet_birthday.len <= 8)) || (zcbor_error(state, ZCBOR_ERR_WRONG_RANGE), false))) || (zcbor_error(state, ZCBOR_ERR_WRONG_RANGE), false))
	&& (zcbor_bstr_encode(state, (&(*input)._Pet_birthday))))
	&& ((((*input)._Pet_species_choice == _Pet_species_cat) ? ((zcbor_uint32_put(state, (1))))
	: (((*input)._Pet_species_choice == _Pet_species_dog) ? ((zcbor_uint32_put(state, (2))))
	: (((*input)._Pet_species_choice == _Pet_species_other) ? ((zcbor_uint32_put(state, (3))))
	: false))))) || (zcbor_list_map_end_force_encode(state), false)) && zcbor_list_end_encode(state, 3))));

	if (!tmp_result)
		zcbor_trace();

	return tmp_result;
}



int cbor_encode_Pet(
		uint8_t *payload, size_t payload_len,
		const struct Pet *input,
		size_t *payload_len_out)
{
	zcbor_state_t states[4];

	zcbor_new_state(states, sizeof(states) / sizeof(zcbor_state_t), payload, payload_len, 1);

	bool ret = encode_Pet(states, input);

	if (ret && (payload_len_out != NULL)) {
		*payload_len_out = MIN(payload_len,
				(size_t)states[0].payload - (size_t)payload);
	}

	if (!ret) {
		int err = zcbor_pop_error(states);

		zcbor_print("Return error: %d\r\n", err);
		return (err == ZCBOR_SUCCESS) ? ZCBOR_ERR_UNKNOWN : err;
	}
	return ZCBOR_SUCCESS;
}
```
