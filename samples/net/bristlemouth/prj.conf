## CMakeLists.txt
```
# SPDX-License-Identifier: Apache-2.0

cmake_minimum_required(VERSION 3.20.0)

find_package(Zephyr REQUIRED HINTS $ENV{ZEPHYR_BASE})
project(net_bristlemouth)


target_sources( app PRIVATE src/main.c)

include(${ZEPHYR_BASE}/samples/net/common/common.cmake)

set(gen_dir ${ZEPHYR_BINARY_DIR}/include/generated/)

add_definitions(
    -DOPENTHREAD_CONFIG_LOG_MAC=1
    -DOPENTHREAD_CONFIG_LOG_PLATFORM=1
)
```

## Kconfig
```
# Private config options for bristlemouth sample app

# Copyright (c) 2018 Intel Corporation
# SPDX-License-Identifier: Apache-2.0

mainmenu "Networking bristlemouth sample application"

config BRISTLEMOUTH_UART_OT
	bool "Enable UART Pipe network interface for OpenThread"
	depends on NET_L2_OPENTHREAD
	help
	  Enable this flag to to allow creation of a UPIPE
	  network interface, usable by 802.15.4/OpenThread

source "Kconfig.zephyr"
```

## sample.yaml
```
common:
  harness: net
  tags: net
  depends_on: netif
  min_flash: 140
sample:
  description: Testing sample for Bristlemouth OT over UART
  name: Bristlemouth OT-UART Bare Sample
```

## prj.conf
```kconfig
# Kernel options
CONFIG_MAIN_STACK_SIZE=2048
CONFIG_ENTROPY_GENERATOR=y
CONFIG_TEST_RANDOM_GENERATOR=y
CONFIG_INIT_STACKS=y

# Generic library options
CONFIG_NEWLIB_LIBC=y
CONFIG_POSIX_API=y
CONFIG_MAX_PTHREAD_COUNT=4

# Generic networking options
CONFIG_NETWORKING=y

CONFIG_NET_IPV4=n
CONFIG_NET_IPV6=y
CONFIG_NET_TCP=n
CONFIG_NET_ARP=y
CONFIG_NET_UDP=y
CONFIG_NET_DHCPV4=n
CONFIG_NET_SHELL=y
CONFIG_NET_MGMT=y
CONFIG_NET_MGMT_EVENT=y

# Sockets
CONFIG_NET_SOCKETS=y
CONFIG_NET_SOCKETS_POSIX_NAMES=y
CONFIG_NET_SOCKETS_POLL_MAX=4

# Network driver config
CONFIG_TEST_RANDOM_GENERATOR=y
CONFIG_INIT_STACKS=y

# Network buffers
CONFIG_NET_PKT_RX_COUNT=16
CONFIG_NET_PKT_TX_COUNT=16
CONFIG_NET_BUF_RX_COUNT=80
CONFIG_NET_BUF_TX_COUNT=80
CONFIG_NET_CONTEXT_NET_PKT_POOL=y

# Network address config
CONFIG_NET_CONFIG_SETTINGS=y
CONFIG_NET_CONFIG_NEED_IPV4=n
CONFIG_NET_CONFIG_NEED_IPV6=y
CONFIG_NET_IPV6_NBR_CACHE=n
CONFIG_NET_IPV6_MLD=n


# IP address options
CONFIG_NET_IF_UNICAST_IPV6_ADDR_COUNT=3
CONFIG_NET_IF_MCAST_IPV6_ADDR_COUNT=4
CONFIG_NET_MAX_CONTEXTS=10

# Openthread options
CONFIG_OPENTHREAD_SHELL=y
CONFIG_SHELL_STACK_SIZE=3072

CONFIG_NET_L2_OPENTHREAD=y
CONFIG_OPENTHREAD_DEBUG=y
CONFIG_OPENTHREAD_L2_DEBUG=y
# CONFIG_OPENTHREAD_L2_LOG_LEVEL_INF=y

CONFIG_IEEE802154_DRIVER_LOG_LEVEL_DBG=y


# CONFIG_OPENTHREAD_JOINER=y
# CONFIG_OPENTHREAD_JOINER_AUTOSTART=y
# CONFIG_OPENTHREAD_COMMISSIONER=y

# mbedTLS options
CONFIG_MBEDTLS_SSL_MAX_CONTENT_LEN=768

CONFIG_OPENTHREAD_NETWORK_NAME="Bristlenet"
CONFIG_OPENTHREAD_CHANNEL=24
CONFIG_OPENTHREAD_XPANID="10:9B:50:10:0E:62:0D:10"
CONFIG_OPENTHREAD_PANID=50665

# In latest zephyr, this changes to NETWORKKEY
CONFIG_OPENTHREAD_NETWORKKEY="00:01:02:03:04:05:06:07:08:09:0a:0b:0c:0d:0e:0f"

# Logging
CONFIG_NET_LOG=y
CONFIG_NET_STATISTICS=y
CONFIG_PRINTK=y
CONFIG_LOG=y

CONFIG_LOG_STRDUP_MAX_STRING=128
CONFIG_LOG_STRDUP_BUF_COUNT=50
CONFIG_LOG_PROCESS_THREAD_SLEEP_MS=50


# Disabling Ethernet
CONFIG_NET_SLIP_TAP=n
# Enable UART PIPE 802.15.4 driver
CONFIG_IEEE802154_UPIPE=y
CONFIG_NET_CONFIG_IEEE802154_DEV_NAME="IEEE802154_UPIPE"

CONFIG_UART_PIPE_ON_DEV_NAME="UART_2"

CONFIG_BRISTLEMOUTH_UART_OT=y
CONFIG_FCB=n
CONFIG_SETTINGS=y
CONFIG_SETTINGS_RUNTIME=y
CONFIG_SETTINGS_FCB=n
CONFIG_ENTROPY_STM32_RNG=y

# Allow manual start of OT
# CONFIG_OPENTHREAD_MANUAL_START=y
```

## src/main.c
```c
/* main.c - OpenThread NCP */

/*
 * Copyright (c) 2020 Tridonic GmbH & Co KG
 *
 * SPDX-License-Identifier: Apache-2.0
 */

#include <logging/log.h>
#include <net/openthread.h>
#include <openthread/dataset.h>

LOG_MODULE_REGISTER(ot_br, LOG_LEVEL_DBG);

#define APP_BANNER "***** OpenThread NCP on Zephyr %s *****"

void main(void)
{
    struct openthread_context* ot_ctx = openthread_get_default_context();
    otInstance* ot_instance = ot_ctx->instance;

    LOG_INF( "Starting OT Manually with params:" );
    LOG_INF( "Network Name: %s", log_strdup(CONFIG_OPENTHREAD_NETWORK_NAME) );
    LOG_INF( "Channel: %d", CONFIG_OPENTHREAD_CHANNEL );
    LOG_INF( "PANID: %d", CONFIG_OPENTHREAD_PANID );
    LOG_INF( "XPANID: %s", log_strdup(CONFIG_OPENTHREAD_XPANID) );
    LOG_INF( "Network Key: %s", log_strdup(CONFIG_OPENTHREAD_NETWORKKEY) );

    // Set up new operational dataset with configured params
    otOperationalDataset op_dataset;
    otDatasetCreateNewNetwork(ot_instance, &op_dataset);
    op_dataset.mChannel = CONFIG_OPENTHREAD_CHANNEL;
    op_dataset.mPanId = CONFIG_OPENTHREAD_PANID;
    otNetworkNameFromString(&op_dataset.mNetworkName, CONFIG_OPENTHREAD_NETWORK_NAME);
    net_bytes_from_str(op_dataset.mExtendedPanId.m8, 8, (char *)CONFIG_OPENTHREAD_XPANID);
    net_bytes_from_str(op_dataset.mNetworkKey.m8, OT_NETWORK_KEY_SIZE,(char *)CONFIG_OPENTHREAD_NETWORKKEY);

    op_dataset.mMeshLocalPrefix.m8[0] = 0xfd;
    memcpy(&op_dataset.mMeshLocalPrefix.m8[1], op_dataset.mExtendedPanId.m8, 5);
    op_dataset.mMeshLocalPrefix.m8[6] = 0x00;
    op_dataset.mMeshLocalPrefix.m8[7] = 0x00;

    // Commit dataset as active
    otDatasetSetActive(ot_instance, &op_dataset);

    // Start OT
    openthread_start(ot_ctx);
    LOG_INF( "Started OT" );
}
```
