## CMakeLists.txt
```
# SPDX-License-Identifier: Apache-2.0

cmake_minimum_required(VERSION 3.20.0)

find_package(Zephyr REQUIRED HINTS $ENV{ZEPHYR_BASE})
project(net_bm_serial_test)

target_sources( app PRIVATE src/main.c)

include(${ZEPHYR_BASE}/samples/net/common/common.cmake)

set(gen_dir ${ZEPHYR_BINARY_DIR}/include/generated/)

zephyr_library_link_libraries_ifdef(CONFIG_BM_DFU MCUBOOT_BOOTUTIL)

add_definitions(
    -DOPENTHREAD_CONFIG_LOG_MAC=1
    -DOPENTHREAD_CONFIG_LOG_PLATFORM=1
)
```

## prj.conf
```kconfig
# Kernel options
CONFIG_MAIN_STACK_SIZE=4096
CONFIG_INIT_STACKS=y

CONFIG_ENTROPY_GENERATOR=y
CONFIG_ENTROPY_STM32_RNG=y

# Generic library options
CONFIG_NEWLIB_LIBC=y
CONFIG_POSIX_API=y
CONFIG_MAX_PTHREAD_COUNT=4

# Logging
CONFIG_LOG=y
CONFIG_PRINTK=y

# TODO: Can these be placed as dependencies/selections in their respective libraries
CONFIG_BOOTLOADER_MCUBOOT=y
CONFIG_FLASH=y
CONFIG_IMG_MANAGER=y
CONFIG_REBOOT=y

# Bristlemouth
CONFIG_BM=y
CONFIG_BM_SERIAL=y
CONFIG_BM_DFU=y
CONFIG_BM_DFU_CLIENT=y
CONFIG_BM_DFU_NUM_FRAMES=2

CONFIG_UART_STM32_BM=y
CONFIG_BM_SERIAL=y
CONFIG_BM_SERIAL_DEV_NAME_0="UART_2"
CONFIG_BM_SERIAL_DEV_NAME_1=""
CONFIG_BM_SERIAL_DEV_NAME_2=""
CONFIG_BM_NUM_FRAMES=40
CONFIG_BM_MAX_FRAME_SIZE=261
CONFIG_BM_TASK_STACK_SIZE=1024
CONFIG_BM_MAX_SERIAL_DEV_COUNT=3
CONFIG_BM_PREAMBLE_LEN=4
CONFIG_BM_PREAMBLE_VAL=85

CONFIG_SMF=y
CONFIG_SMF_ANCESTOR_SUPPORT=y
```

## src/main.c
```c
/* main.c - OpenThread NCP */

/*
 * Copyright (c) 2020 Tridonic GmbH & Co KG
 *
 * SPDX-License-Identifier: Apache-2.0
 */
#include <zephyr.h>

#include <stdio.h>
#include <stdlib.h>
#include <unistd.h>

#include <device.h>
#include <devicetree.h>
#include <drivers/gpio.h>
#include <logging/log.h>
#include <drivers/bm/bm_serial.h>
#include <drivers/bm/bm_dfu.h>
#include <bootutil/bootutil_public.h>

#define LOG_MODULE_NAME bm_test
LOG_MODULE_REGISTER(LOG_MODULE_NAME, LOG_LEVEL_DBG);

void main(void)
{
    LOG_INF( "This is the new image!" );
    boot_set_confirmed();
    bm_dfu_update_end(BM_END_DEVICE, 1, BM_DFU_ERR_NONE);

    while (1)
    {
        usleep(1000000UL);
    }
}
```
