## CMakeLists.txt
```
# SPDX-License-Identifier: Apache-2.0

cmake_minimum_required(VERSION 3.20.0)

find_package(Zephyr REQUIRED HINTS $ENV{ZEPHYR_BASE})
project(net_bm_net_test)

target_sources( app PRIVATE src/main.c)

include(${ZEPHYR_BASE}/samples/net/common/common.cmake)

set(gen_dir ${ZEPHYR_BINARY_DIR}/include/generated/)
```

## sample.yaml
```
common:
  harness: net
  tags: net
  depends_on: netif
  min_flash: 140
sample:
  description: Testing bm_net
  name: BM Net Sample
```

## prj.conf
```kconfig
# Kernel options
CONFIG_MAIN_STACK_SIZE=4096
CONFIG_ENTROPY_GENERATOR=y
CONFIG_ENTROPY_STM32_RNG=y
CONFIG_INIT_STACKS=y

# Generic library options
CONFIG_NEWLIB_LIBC=y
CONFIG_POSIX_API=y
CONFIG_MAX_PTHREAD_COUNT=4

# Networking config
CONFIG_NETWORKING=y
CONFIG_NET_IPV6=y
CONFIG_NET_IPV6_MLD=n
CONFIG_NET_IPV6_NBR_CACHE=n
CONFIG_NET_SOCKETS=y
CONFIG_NET_SOCKETS_POLL_MAX=4

# Network shell
CONFIG_NET_SHELL=y

# Bristlemouth
CONFIG_NET_L2_BRISTLEMOUTH=y

CONFIG_BM_STM32_HAL=y
CONFIG_BM_STM32_HAL_RANDOM_MAC=y
CONFIG_BM_STM32_HAL_ENABLE_MANCHESTER_CODING=n
CONFIG_BM_STM32_HAL_MAC3=0xAB
CONFIG_BM_STM32_HAL_MAC4=0xCD
CONFIG_BM_STM32_HAL_MAC5=0xEF
CONFIG_BM_STM32_HAL_NUM_FRAMES=5
CONFIG_BM_STM32_HAL_MAX_FRAME_SIZE=1524

CONFIG_UART_BM=y
CONFIG_BM_STM32_HAL_MAX_SERIAL_DEV_COUNT=2
CONFIG_BM_STM32_HAL_SERIAL_DEV_NAME_0="UART_2"
CONFIG_BM_STM32_HAL_SERIAL_DEV_NAME_1="UART_3"

# Logging
CONFIG_LOG=y
CONFIG_PRINTK=y
CONFIG_NET_LOG=y
CONFIG_NET_STATISTICS=y

# Log Levels
# CONFIG_NET_CORE_LOG_LEVEL_DBG=y
# CONFIG_NET_IPV6_LOG_LEVEL_DBG=y
# CONFIG_NET_CONN_LOG_LEVEL_DBG=y
# CONFIG_NET_L2_BRISTLEMOUTH_LOG_LEVEL_DBG=y
CONFIG_NET_L2_BRISTLEMOUTH_DRIVER_LOG_LEVEL_DBG=y

# CONFIG_BOOTLOADER_MCUBOOT=y
```

## src/main.c
```c
/* main.c - Bristlemouth L2 Network Test */

/*
 * Copyright (c) 2022 Sofar Ocean Technologies
 *
 * SPDX-License-Identifier: Apache-2.0
 */
#include <zephyr.h>

#include <stdio.h>
#include <stdlib.h>
#include <unistd.h>

#include <device.h>
#include <devicetree.h>

#include <logging/log.h>


#include <zephyr/zephyr.h>
#include <zephyr/sys/printk.h>
#include <zephyr/net/socket.h>

#define LOG_MODULE_NAME bm_test
LOG_MODULE_REGISTER(LOG_MODULE_NAME, LOG_LEVEL_DBG);

static char recv_buf[1500];
static char str_data[256];

void main(void)
{
    LOG_INF( "Testing the BM Net Driver" );

    int ret;
    int sock;
    struct sockaddr_in6 addr6;

    addr6.sin6_family = AF_INET6;
    addr6.sin6_port = htons(9999);
    zsock_inet_pton(AF_INET6, "ff03::1", &addr6.sin6_addr);

    struct sockaddr* addr = (struct sockaddr *)&addr6;

    sock = zsock_socket(addr->sa_family, SOCK_DGRAM, IPPROTO_UDP);
    if( sock < 0 ) 
    {
		LOG_ERR("Failed to create UDP socket: %d", errno);
	}

    ret = zsock_bind( sock, addr, sizeof(addr6) );
    if (ret < 0) {
		LOG_ERR("Cannot bind to UDP addr/port: %d", errno);
	}
    else
    {
        LOG_INF( "Bound" );
    }

    while (1)
    {
        int received;
        LOG_INF( "Waiting for data" );
	    received = zsock_recv(sock, recv_buf, sizeof(recv_buf), 0);

        if(received == -EAGAIN) {
            LOG_INF( "Timeout" );
		} else if (ret < 0) {
			LOG_ERR( "Failed to recv" );
		}
        else
        {
            memcpy( str_data, recv_buf, received );
            str_data[received] = 0;
            
            LOG_INF( "Got %d bytes: '%s'", received, str_data );

        }
    }
}
```
