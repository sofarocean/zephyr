## CMakeLists.txt
```
# SPDX-License-Identifier: Apache-2.0

cmake_minimum_required(VERSION 3.20.0)

find_package(Zephyr REQUIRED HINTS $ENV{ZEPHYR_BASE})
project(net_bm_cobs_testing)

target_sources( app PRIVATE src/main.c)

include(${ZEPHYR_BASE}/samples/net/common/common.cmake)

set(gen_dir ${ZEPHYR_BINARY_DIR}/include/generated/)

add_definitions(
    -DOPENTHREAD_CONFIG_LOG_MAC=1
    -DOPENTHREAD_CONFIG_LOG_PLATFORM=1
)
```

## prj.conf
```kconfig
# Kernel options
CONFIG_MAIN_STACK_SIZE=4096
CONFIG_ENTROPY_GENERATOR=y
CONFIG_TEST_RANDOM_GENERATOR=y
CONFIG_INIT_STACKS=y

# Generic library options
CONFIG_NEWLIB_LIBC=y
CONFIG_POSIX_API=y
CONFIG_MAX_PTHREAD_COUNT=4

CONFIG_IEEE802154_DRIVER_LOG_LEVEL_DBG=y

# Logging
CONFIG_NET_LOG=y
CONFIG_NET_STATISTICS=y
CONFIG_PRINTK=y
CONFIG_LOG=y

CONFIG_LOG_STRDUP_MAX_STRING=128
CONFIG_LOG_STRDUP_BUF_COUNT=50
CONFIG_LOG_PROCESS_THREAD_SLEEP_MS=50



CONFIG_COBS=y
CONFIG_NET_CONFIG_IEEE802154_DEV_NAME="IEEE802154_UPIPE"
CONFIG_BM_SERIAL_DEV_NAME_0="UART_2"

CONFIG_BM=y
CONFIG_BM_SERIAL=y
CONFIG_IEEE802154_BM_SERIAL=y
```

## src/main.c
```c
/* main.c - OpenThread NCP */

/*
 * Copyright (c) 2020 Tridonic GmbH & Co KG
 *
 * SPDX-License-Identifier: Apache-2.0
 */
#include <zephyr.h>

#include <stdio.h>
#include <stdlib.h>
#include <unistd.h>

#include <device.h>
#include <devicetree.h>
#include <drivers/gpio.h>

#include <logging/log.h>

#include <drivers/gpio.h>
#include <net/ieee802154_radio.h>
#include <drivers/bm/bm_serial.h>

#define LOG_MODULE_NAME bristlemouth_test
LOG_MODULE_REGISTER(LOG_MODULE_NAME, LOG_LEVEL_DBG);

static struct k_thread sample_rx_thread;
K_THREAD_STACK_DEFINE(sample_rx_stack, CONFIG_BM_TASK_STACK_SIZE);
static struct k_thread sample_tx_thread;
K_THREAD_STACK_DEFINE(sample_tx_stack, CONFIG_BM_TASK_STACK_SIZE);

#define IS_PRODUCER 1

#define USER0_NODE DT_ALIAS(user0)
#define USER1_NODE DT_ALIAS(user1)

/* These map to D3/D4 on the L496ZG Nucleo*/
static const struct gpio_dt_spec user0 = GPIO_DT_SPEC_GET(USER0_NODE, gpios);
static const struct gpio_dt_spec user1 = GPIO_DT_SPEC_GET(USER1_NODE, gpios);

static void _tx_thread(void)
{
    static uint8_t counter = 0;
    int retval;
    uint8_t tx_buf[140];
    uint8_t msg[] = "loWorldHelloWorldHelloWorldHelloWorldHelloWorldHelloWorldHelloWorldHelloWorldHelloWorldHelloWorldHelloWorldHelloWorldWeAreDone";
    bm_frame_header_t frm_hdr = {BM_V0, BM_GENERIC, sizeof(msg)};

    memcpy(tx_buf, &frm_hdr, sizeof(bm_frame_header_t));
	memcpy(&tx_buf[sizeof(bm_frame_header_t)], msg, frm_hdr.payload_length);

     while (1)
    {
        /* add a counter value for rx to watch for */
        memcpy(&tx_buf[sizeof(bm_frame_header_t)], &counter, sizeof(counter));
        bm_frame_t *bm_frm = (bm_frame_t *)tx_buf;
        counter++;

        retval = bm_serial_frm_put(bm_frm);
	    if (retval)
	    {
		    LOG_ERR( "TX MessageQueue is full, dropping message!");
	    }
        usleep(5000UL);
    }
}

static void _rx_thread(void)
{
	struct k_msgq* sample_rx_queue = NULL;
	bm_msg_t msg;
	uint16_t frame_length;
	uint16_t payload_length;
    static uint8_t last_val = 0;
    uint8_t current_val;
    static uint8_t first = 1;

    while (sample_rx_queue == NULL)
	{
		sample_rx_queue = bm_serial_get_rx_msgq_handler();
	} 

    while (1)
	{
		// Wait on bm_serial.c RX Thread to put message on queue
		k_msgq_get(sample_rx_queue, &msg, K_FOREVER);
		frame_length = msg.frame_length;
		payload_length = frame_length - sizeof(bm_frame_header_t);
		uint8_t bm_version = ((bm_frame_header_t*) msg.frame_addr)->version;

		if (bm_version != BM_GENERIC)
		{
			LOG_ERR("Incompatible version. Discarding Frame");
			continue;
		}

        current_val = (uint8_t) *(msg.frame_addr + sizeof(bm_frame_header_t));
        if (first)
        {
            first = 0;
        }
        else
        {
            if (current_val == 0 && last_val == 255)
            {
                LOG_INF("wrapped around");
            }
            else if (current_val != (last_val +1))
            {
                LOG_ERR("C: %d L: %d", current_val, last_val);
                gpio_pin_toggle_dt(&user1);
            }
            else
            {
                gpio_pin_toggle_dt(&user0);
            }
        }
        last_val = current_val;
	}
}

void main(void)
{
    LOG_INF( "Testing the UPIPE COBS Decoding/Encoding functionality" );

    /* Checking/Setting up GPIO Debug Pins */
    if (!device_is_ready(user0.port))
    {
        LOG_ERR("GPIO 0 Port not ready");
    }

    if (!device_is_ready(user1.port))
    {
        LOG_ERR("GPIO 1 Port not ready");
    }

    int ret = gpio_pin_configure_dt(&user0, GPIO_OUTPUT_ACTIVE);
    if (ret < 0) 
    {
        LOG_ERR("GPIO 0 unable to be configured\n");
    }

    ret = gpio_pin_configure_dt(&user1, GPIO_OUTPUT_ACTIVE);
    if (ret < 0) 
    {
        LOG_ERR("GPIO 1 unable to be configured\n");
    }

	k_thread_create(&sample_rx_thread, sample_rx_stack,
		K_THREAD_STACK_SIZEOF(sample_rx_stack),
		(k_thread_entry_t)_rx_thread,
		NULL, NULL, NULL, K_PRIO_COOP(5), 0, K_NO_WAIT);

#if IS_PRODUCER== 1
    k_thread_create(&sample_tx_thread, sample_tx_stack,
		K_THREAD_STACK_SIZEOF(sample_tx_stack),
		(k_thread_entry_t)_tx_thread,
		NULL, NULL, NULL, K_PRIO_COOP(5), 0, K_NO_WAIT);
#endif
}
```
